## conf/machine/fio-imx8mn-var-som.conf
```bitbake
#@TYPE: Machine
#@NAME: Variscite VAR-SOM-MX8M-NANO DDR4
#@SOC: i.MX8MN
#@DESCRIPTION: Machine configuration for Variscite VAR-SOM-MX8M-NANO DDR4
#@MAINTAINER: Nate Drude <nate.d@variscite.com>
#
# http://www.variscite.com

MACHINEOVERRIDES =. "imx8mn-var-som:mx8m-var:"

require conf/machine/imx8mn-var-som.conf

KMACHINE = "imx8mn-var-som"
```

## conf/machine/fio-imx8mp-var-som.conf
```bitbake
#@TYPE: Machine
#@NAME: Variscite VAR-SOM-MX8M-PLUS
#@SOC: i.MX8MP
#@DESCRIPTION: Machine configuration for Variscite VAR-SOM-MX8M-PLUS (only)
#@MAINTAINER: Nate Drude <nate.d@variscite.com>
#
# http://www.variscite.com

MACHINEOVERRIDES =. "imx8mp-var-dart:mx8m-var:"

require conf/machine/imx8mp-var-dart.conf

KMACHINE = "imx8mp-var-dart"
```

## conf/machine/i1200-demo-ebbr.conf
```bitbake
#@TYPE: Machine
#@NAME: Mediatek i1200 Demo board with support for EBBR
#@SOC: mt8195
#@DESCRIPTION: Machine configuration for Mediatek i1200 Demo board
#              following the EBBR requirements (UEFI)

MACHINEOVERRIDES =. "i1200-demo:"

require conf/machine/i1200-demo.conf

KMACHINE = "i1200-demo"
MACHINE_FEATURES += "efi ebbr"
```

## conf/machine/imx8mm-var-dart.conf
```bitbake
#@TYPE: Machine
#@NAME: Variscite DART-MX8M-MINI
#@SOC: i.MX8MM
#@DESCRIPTION: Machine configuration for Variscite DART-MX8M-MINI and VAR-SOM-MX8M-MINI

MACHINEOVERRIDES =. "mx8:mx8m:mx8mm:imx8mmevk:"

require conf/machine/include/imx-base.inc
require conf/machine/include/tune-cortexa53.inc

MACHINE_FEATURES = " optee"

UBOOT_CONFIG ??= "sd"
UBOOT_CONFIG[sd] = "imx8mm_var_dart_config,sdcard"
SPL_BINARY = "spl/u-boot-spl.bin"

# Set DDR FIRMWARE
DDR_FIRMWARE_NAME = " \
	ddr4_imem_1d.bin \
	ddr4_dmem_1d.bin \
	ddr4_imem_2d.bin \
	ddr4_dmem_2d.bin \
	lpddr4_pmu_train_1d_imem.bin \
	lpddr4_pmu_train_1d_dmem.bin \
	lpddr4_pmu_train_2d_imem.bin \
	lpddr4_pmu_train_2d_dmem.bin \
"

# Set U-Boot DTB
UBOOT_DTB_NAME = "imx8mm-var-som-symphony.dtb"

# Set imx-mkimage boot target
IMXBOOT_TARGETS = "flash_evk_spl"

SERIAL_CONSOLES = "115200;ttymxc3"

IMAGE_BOOTLOADER = "imx-boot"

ROOTFS_SIZE = "3700"
LOADADDR = ""
UBOOT_SUFFIX = "bin"
UBOOT_MAKE_TARGET = ""
IMX_BOOT_SEEK = "33"

ATF_LOAD_ADDR = "0x920000"

OPTEE_BIN_EXT = "8mm"
TEE_LOAD_ADDR = "0xbe000000"
```

## conf/machine/imx8mm-var-som-symphony.conf
```bitbake
#@TYPE: Machine
#@NAME: Variscite VAR-SOM-MX8M-MINI DDR4
#@SOC: i.MX8MM
#@DESCRIPTION: Machine configuration for Variscite VAR-SOM-MX8M-MINI DDR4
#@MAINTAINER: Nate Drude <nate.d@variscite.com>
#
# http://www.variscite.com

MACHINEOVERRIDES =. "imx8mm-var-dart:mx8m-var:"

require conf/machine/imx8mm-var-dart.conf
```

## conf/machine/imx8mn-var-som.conf
```bitbake
#@TYPE: Machine
#@NAME: Variscite VAR-SOM-MX8M-NANO
#@SOC: i.MX8MN
#@DESCRIPTION: Machine configuration for Variscite VAR-SOM-MX8M-NANO for LmP
#@MAINTAINER: Felix Radensky <felix.r@variscite.com>
#
# http://www.variscite.com

MACHINEOVERRIDES =. "mx8:mx8m:mx8mn:mx8m-var:"
require conf/machine/include/imx-base.inc
require conf/machine/include/tune-cortexa53.inc

MACHINE_FEATURES_append = " optee pci bluetooth wifi bcm4339 bcm43430"

UBOOT_CONFIG ??= "sd"
UBOOT_CONFIG[sd] = "imx8mn_var_som_config,sdcard"
SPL_BINARY = "spl/u-boot-spl.bin"

# Set DDR FIRMWARE
DDR_FIRMWARE_VERSION = "201810"
DDR_FIRMWARE_NAME = " \
    ddr4_imem_1d_${DDR_FIRMWARE_VERSION}.bin \
    ddr4_dmem_1d_${DDR_FIRMWARE_VERSION}.bin \
    ddr4_imem_2d_${DDR_FIRMWARE_VERSION}.bin \
    ddr4_dmem_2d_${DDR_FIRMWARE_VERSION}.bin \
"

# Set U-Boot DTB
UBOOT_DTB_NAME = "imx8mn-var-som-symphony.dtb"

# Set imx-mkimage boot target
IMXBOOT_TARGETS_imx8mn-var-som = "flash_evk_spl_var"

SERIAL_CONSOLES = "115200;ttymxc3"

IMAGE_BOOTLOADER = "imx-boot"

ROOTFS_SIZE = "3700"
LOADADDR = ""
UBOOT_SUFFIX = "bin"
UBOOT_MAKE_TARGET = ""

# Image boot offset as defined in section 6.1.6.1 "Primary image offset and IVT offset" of
# i.MX 8M Nano Applications Processor Reference Manual, Rev. 0, 12/2019
# Doc ID: IMX8MNRM
IMX_BOOT_SEEK = "32"

ATF_LOAD_ADDR = "0x960000"
ATF_PLATFORM = "imx8mn"
IMX_BOOT_SOC_TARGET = "iMX8MN"

OPTEE_BIN_EXT = "8mn"
TEE_LOAD_ADDR = "0x56000000"

MACHINE_EXTRA_RRECOMMENDS += " \
	bcm43xx-utils \
	brcm-patchram-plus \
"
```

## conf/machine/include/bbmask-fix.inc
```bitbake
BBMASK:mx8m-nxp-bsp += " \
    /meta-virtualization/recipes-kernel/linux/linux-%.bbappend \
    /meta-virtualization/dynamic-layers/xilinx/recipes-extended/xen/xen_4.14.bbappend \
    /meta-security/meta-integrity/recipes-core/systemd/systemd_%.bbappend \
    /meta-xilinx-tools/recipes-bsp/ai-engine/aiefal_1.0.bb \
    /meta-xilinx-tools/recipes-bsp/u-boot/u-boot-xlnx_%.bbappend \
    /meta-st-stm32mp/recipes-core/busybox/busybox_%.bbappend \
    /meta-st-stm32mp/recipes-graphics/drm/libdrm_2.4.110.bbappend \
    /meta-st-stm32mp/recipes-graphics/drm/libdrm_2.4.113.bbappend \
    /meta-st-stm32mp/recipes-bsp/trusted-firmware-a/tf-a-stm32mp_2.6.bb \
    /meta-ti/meta-ti-bsp/recipes-security/optee/optee-test_%.bbappend \
    /meta-ti/meta-ti-bsp/recipes-security/optee/optee-client_3.16%.bbappend \
    /meta-ti/meta-ti-bsp/recipes-security/optee/optee-os_3.16%.bbappend \
    /meta-ti/meta-ti-bsp/recipes-security/optee/optee-os-tadevkit_%.bbappend \
    /meta-ti/meta-ti-bsp/recipes-security/optee/optee-examples_%.bbappend \
    /meta-phytec/dynamic-layers/stm-st-stm32mp/recipes-bsp/trusted-firmware-a/tf-a-stm32mp_%.bbappend \
    /meta-phytec/recipes-bsp/u-boot/libubootenv_%.bbappend \
"
```

## conf/machine/phyboard-pollux-imx8mp-3-sec.conf
```bitbake
#@TYPE: Machine
#@NAME: Phytec i.MX8MP Pollux Secure
#@SOC: i.MX8MP
#@DESCRIPTION: Machine configuration for Phytec i.MX8MP Pollux
#              with secure boot enabled by default
#@MAINTAINER: Vanessa Maegima <vanessa.maegima@foundries.io>

MACHINEOVERRIDES =. "phyboard-pollux-imx8mp-3:"

require conf/machine/phyboard-pollux-imx8mp-3.conf

KMACHINE = "phyboard-pollux-imx8mp-3"

MACHINE_FEATURES += "fiovb"
```
