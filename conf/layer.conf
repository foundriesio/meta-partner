## conf/machine/include/lmp-partner-custom-nxp-imx.inc
```bitbake
# LMP partner specific customizations (either replace or extend options as defined by meta-lmp)

## non-clangable adjustments for nxp-imx
OBJCOPY:pn-linux-lmp-dev-mfgtool:toolchain-clang = "${HOST_PREFIX}objcopy"
STRIP:pn-linux-lmp-dev-mfgtool:toolchain-clang = "${HOST_PREFIX}strip"
OBJCOPY:pn-linux-lmp-fslc-imx:toolchain-clang = "${HOST_PREFIX}objcopy"
STRIP:pn-linux-lmp-fslc-imx:toolchain-clang = "${HOST_PREFIX}strip"
OBJCOPY:pn-linux-lmp-fslc-imx-rt:toolchain-clang = "${HOST_PREFIX}objcopy"
STRIP:pn-linux-lmp-fslc-imx-rt:toolchain-clang = "${HOST_PREFIX}strip"

# lmp-mfgtool distro
TOOLCHAIN:pn-optee-os-fio-mfgtool = "gcc"

# imx targets (not reproducible)
TOOLCHAIN:pn-imx-atf = "gcc"
TOOLCHAIN:pn-qoriq-atf = "gcc"

# U-boot does compile with clang but clang-15 crashes compiling it :(
TOOLCHAIN:pn-u-boot-fio-mfgtool = "gcc"

# isp-imx fails to build with clang
TOOLCHAIN:pn-isp-imx = "gcc"

# Common for iMX targets

## Prefer IMX_DEFAULT_BSP=nxp as mainline removes every common machine override
IMX_DEFAULT_BSP = "nxp"
OSTREE_KERNEL_ARGS:mx6-generic-bsp ?= "console=tty1 console=ttymxc0,115200 ${OSTREE_KERNEL_ARGS_COMMON}"
OSTREE_KERNEL_ARGS:mx6ull-generic-bsp ?= "console=tty1 console=ttymxc0,115200 ${OSTREE_KERNEL_ARGS_COMMON}"

# iMX6UL
UBOOT_SIGN_ENABLE:sota:mx6ul-generic-bsp ??= "1"
PREFERRED_PROVIDER_virtual/kernel:mx6ul-nxp-bsp ?= "linux-lmp-fslc-imx"
IMX_DEFAULT_BOOTLOADER:mx6ul-generic-bsp ?= "u-boot-fio"
WKS_FILE_DEPENDS:append:mx6ul-generic-bsp = " u-boot-default-script"
PREFERRED_PROVIDER_u-boot-default-script:mx6ul-generic-bsp = "u-boot-base-scr"
PREFERRED_PROVIDER_u-boot-default-script:sota:mx6ul-generic-bsp = "u-boot-ostree-scr-fit"
SPL_BINARY:mx6ul-generic-bsp = "SPL"
UBOOT_CLASSES:mx6ul-generic-bsp = "uboot-fitimage"
UBOOT_CONFIG:mx6ul-generic-bsp = "sd"
UBOOT_SUFFIX:mx6ul-generic-bsp = "bin"
UBOOT_MAKE_TARGET:mx6ul-generic-bsp = ""
UBOOT_DTB_LOADADDRESS:mx6ul-generic-bsp = "0x85800000"
UBOOT_RD_LOADADDRESS:mx6ul-generic-bsp = "0x84000000"
MACHINE_FEATURES:append:mx6ul-generic-bsp = " optee"
LMP_BOOT_FIRMWARE_FILES:mx6ul-generic-bsp = "SPL u-boot.itb"
IMAGE_BOOT_FILES:sota:mx6ul-generic-bsp = " boot.itb"
IMAGE_BOOT_FILES:mx6ul-generic-bsp = " boot.scr uEnv.txt zImage ${@make_dtb_boot_files(d)}"
KERNEL_IMAGETYPE:sota:mx6ul-generic-bsp = "fitImage"
KERNEL_CLASSES:sota:mx6ul-generic-bsp = " kernel-lmp-fitimage "
WKS_FILE:mx6ul-generic-bsp:sota = "sdimage-imx6-spl-fit-sota.wks"
PREFERRED_VERSION_u-boot-fio:mx6ul-nxp-bsp ?= "imx-2024.04"
# iMX6UL EVK
UBOOT_SIGN_ENABLE:sota:imx6ulevk ?= "1"
SOTA_CLIENT_FEATURES:append:imx6ulevk = " ubootenv"
BOOTSCR_LOAD_ADDR:imx6ulevk = "0x85000000"

# iMX6ULL
UBOOT_SIGN_ENABLE:sota:mx6ull-generic-bsp ??= "1"
PREFERRED_PROVIDER_virtual/kernel:mx6ull-nxp-bsp ?= "linux-lmp-fslc-imx"
IMX_DEFAULT_BOOTLOADER:mx6ull-generic-bsp ?= "u-boot-fio"
WKS_FILE_DEPENDS:append:mx6ull-generic-bsp = " u-boot-default-script"
PREFERRED_PROVIDER_u-boot-default-script:mx6ull-generic-bsp = "u-boot-base-scr"
PREFERRED_PROVIDER_u-boot-default-script:sota:mx6ull-generic-bsp = "u-boot-ostree-scr-fit"
SPL_BINARY:mx6ull-generic-bsp = "SPL"
UBOOT_CLASSES:mx6ull-generic-bsp = "uboot-fitimage"
UBOOT_CONFIG:mx6ull-generic-bsp = "sd"
UBOOT_SUFFIX:mx6ull-generic-bsp = "bin"
UBOOT_MAKE_TARGET:mx6ull-generic-bsp = ""
UBOOT_DTB_LOADADDRESS:mx6ull-generic-bsp = "0x85800000"
UBOOT_RD_LOADADDRESS:mx6ull-generic-bsp = "0x84000000"
MACHINE_FEATURES:append:mx6ull-generic-bsp = " optee"
LMP_BOOT_FIRMWARE_FILES:mx6ull-generic-bsp = "SPL u-boot.itb"
IMAGE_BOOT_FILES:sota:mx6ull-generic-bsp = " boot.itb"
IMAGE_BOOT_FILES:mx6ull-generic-bsp = " boot.scr uEnv.txt zImage ${@make_dtb_boot_files(d)}"
KERNEL_IMAGETYPE:sota:mx6ull-generic-bsp = "fitImage"
KERNEL_CLASSES:sota:mx6ull-generic-bsp = " kernel-lmp-fitimage "
WKS_FILE:mx6ull-generic-bsp:sota = "sdimage-imx6-spl-fit-sota.wks"
PREFERRED_VERSION_u-boot-fio:mx6ull-nxp-bsp ?= "imx-2024.04"
# iMX6ULL EVK
UBOOT_SIGN_ENABLE:sota:imx6ullevk ?= "1"
SOTA_CLIENT_FEATURES:append:imx6ullevk = " ubootenv"
BOOTSCR_LOAD_ADDR:imx6ullevk = "0x85000000"

# iMX8QM
SOTA_CLIENT_FEATURES:append:mx8qm-generic-bsp = " ubootenv"
IMAGE_BOOT_FILES:mx8qm-nxp-bsp = "imx-boot u-boot.itb hdmitxfw.bin ${KERNEL_IMAGETYPE} ${@make_dtb_boot_files(d)} boot.scr uEnv.txt"
IMAGE_BOOT_FILES:sota:mx8qm-nxp-bsp = "imx-boot u-boot.itb"
LMP_BOOT_FIRMWARE_FILES:mx8qm-nxp-bsp = "imx-boot u-boot.itb"
BOOTSCR_LOAD_ADDR:mx8qm-generic-bsp = "0x83100000"
KERNEL_IMAGETYPE:sota:mx8qm-generic-bsp = "fitImage"
KERNEL_CLASSES:sota:mx8qm-generic-bsp = " kernel-lmp-fitimage "
FIT_LOADABLES:mx8qm-generic-bsp ?= "hdmitxfw.bin"
WKS_FILE:mx8qm-nxp-bsp:sota = "sdimage-imx8-sota.wks.in"
IMX_DEFAULT_BOOTLOADER:mx8qm-generic-bsp ?= "u-boot-fio"
WKS_FILE_DEPENDS:append:mx8qm-generic-bsp = " u-boot-default-script imx-boot"
PREFERRED_PROVIDER_u-boot-default-script:mx8qm-generic-bsp = "u-boot-base-scr"
PREFERRED_PROVIDER_u-boot-default-script:sota:mx8qm-generic-bsp = "u-boot-ostree-scr-fit"
UBOOT_CLASSES:mx8qm-generic-bsp = "uboot-fitimage"
IMXBOOT_TARGETS:mx8qm-nxp-bsp = "flash_evk_spl"
ATF_BINARY:mx8qm-generic-bsp = "arm-trusted-firmware.bin"
EXTRA_IMAGEDEPENDS:append:mx8qm-generic-bsp = "virtual/trusted-firmware-a"
UBOOT_ENTRYPOINT:mx8qm-generic-bsp = "0x80280000"
UBOOT_LOADADDRESS:mx8qm-generic-bsp = "0x80280000"
UBOOT_DTB_LOADADDRESS:mx8qm-generic-bsp = "0x83000000"
UBOOT_SIGN_ENABLE:sota:mx8qm-generic-bsp ??= "1"
PREFERRED_VERSION_u-boot-fio:mx8qm-nxp-bsp ?= "imx-2024.04"
## iMX8QM MEK
UBOOT_SIGN_ENABLE:sota:imx8qm-mek ?= "1"
OSTREE_KERNEL_ARGS:imx8qm-mek ?= "pci=nomsi console=ttyLP0,115200 earlycon ${OSTREE_KERNEL_ARGS_COMMON}"
PREFERRED_PROVIDER_virtual/kernel:imx8qm-mek ?= "linux-lmp-fslc-imx"
KERNEL_DANGLING_FEATURES_WARN_ONLY:imx8qm-mek ?= "1"
UBOOT_SUFFIX:imx8qm-mek = "bin"
UBOOT_DTB_NAME:imx8qm-mek ?= "fsl-imx8qm-mek.dtb"

# NXP i.MX 8QuadMax MEK with secure boot support
SOTA_CLIENT_FEATURES:remove:sota:imx8qm-mek-sec = "ubootenv"

# iMX8MQ
UBOOT_SIGN_ENABLE:sota:mx8mq-generic-bsp ??= "1"
IMX_DEFAULT_BOOTLOADER:mx8mq-generic-bsp ?= "u-boot-fio"
UBOOT_ENTRYPOINT:mx8mq-generic-bsp = "0x40400000"
UBOOT_DTB_LOADADDRESS:mx8mq-generic-bsp = "0x43000000"
PREFERRED_PROVIDER_virtual/trusted-firmware-a:mx8mq-nxp-bsp ?= "imx-atf"
EXTRA_IMAGEDEPENDS:append:mx8mq-generic-bsp = "virtual/trusted-firmware-a"
UBOOT_CLASSES:mx8mq-generic-bsp = "uboot-fitimage"
ATF_BINARY:mx8mq-generic-bsp = "arm-trusted-firmware.bin"
LMP_BOOT_FIRMWARE_FILES:mx8mq-nxp-bsp = "imx-boot imx-boot-nohdmi u-boot.itb"
IMAGE_BOOT_FILES:mx8mq-nxp-bsp = "imx-boot u-boot.itb ${KERNEL_IMAGETYPE} ${@make_dtb_boot_files(d)} boot.scr uEnv.txt"
IMAGE_BOOT_FILES:sota:mx8mq-nxp-bsp = "imx-boot u-boot.itb boot.itb"
WKS_FILE_DEPENDS:append:mx8mq-generic-bsp = " u-boot-default-script imx-boot"
PREFERRED_PROVIDER_u-boot-default-script:mx8mq-generic-bsp = "u-boot-base-scr"
PREFERRED_PROVIDER_u-boot-default-script:sota:mx8mq-generic-bsp = "u-boot-ostree-scr-fit"
KERNEL_IMAGETYPE:sota:mx8mq-generic-bsp = "fitImage"
KERNEL_CLASSES:sota:mx8mq-generic-bsp = " kernel-lmp-fitimage "
PREFERRED_VERSION_u-boot-fio:mx8mq-nxp-bsp ?= "imx-2024.04"
## iMX8: Use latest NXP BSP downstream kernel
PREFERRED_PROVIDER_virtual/kernel:mx8mq-nxp-bsp ?= "linux-lmp-fslc-imx"
WKS_FILE:sota:mx8mq-nxp-bsp = "sdimage-imx8m-spl-sota.wks.in"
IMXBOOT_TARGETS:mx8mq-nxp-bsp = "flash_evk_spl"
## iMX8MQ EVK
UBOOT_SIGN_ENABLE:sota:imx8mq-evk ?= "1"
KMACHINE:imx8mq-evk = "imx8mqevk"
OSTREE_KERNEL_ARGS:imx8mq-evk ?= "console=tty1 console=ttymxc0,115200 earlycon=ec_imx6q,0x30860000,115200 rootfstype=ext4"
SOTA_CLIENT_FEATURES:append:imx8mq-evk = " ubootenv"
MACHINE_FEATURES:remove:imx8mq-evk = "qca6174"
MACHINE_FEATURES:append:imx8mq-evk = " bcm4356"
BOOTSCR_LOAD_ADDR:imx8mq-evk = "0x44800000"
MACHINE_EXTRA_RRECOMMENDS:append:imx8mq-evk = " bluetooth-attach"
MACHINE_FIRMWARE:append:imx8mq-evk = " linux-firmware-bcm4356-pcie"
## iMX8MQ EVK with EBBR / SystemReady
UBOOT_SIGN_ENABLE:sota:imx8mq-evk-ebbr ?= ""
KERNEL_IMAGETYPE:sota:imx8mq-evk-ebbr ?= "Image"
KERNEL_CLASSES:sota:imx8mq-evk-ebbr ?= ""
EFI_PROVIDER:imx8mq-evk-ebbr ?= "grub-efi"
OSTREE_BOOTLOADER:imx8mq-evk-ebbr ?= "grub"
OSTREE_KERNEL_ARGS:append:imx8mq-evk-ebbr = " root=LABEL=otaroot"
IMAGE_EFI_BOOT_FILES:sota:imx8mq-evk-ebbr ?= "${@make_efi_dtb_boot_files(d)}"
WKS_FILE:sota:imx8mq-evk-ebbr ?= "efidisk-sota.wks.in"

# iMX8MM
UBOOT_SIGN_ENABLE:sota:mx8mm-generic-bsp ??= "1"
IMX_DEFAULT_BOOTLOADER:mx8mm-generic-bsp ?= "u-boot-fio"
UBOOT_ENTRYPOINT:mx8mm-generic-bsp = "0x40400000"
UBOOT_DTB_LOADADDRESS:mx8mm-generic-bsp = "0x43000000"
PREFERRED_PROVIDER_virtual/trusted-firmware-a:mx8mm-nxp-bsp ?= "imx-atf"
EXTRA_IMAGEDEPENDS:append:mx8mm-nxp-bsp = "virtual/trusted-firmware-a"
UBOOT_CLASSES:mx8mm-generic-bsp = "uboot-fitimage"
ATF_BINARY:mx8mm-generic-bsp = "arm-trusted-firmware.bin"
LMP_BOOT_FIRMWARE_FILES:mx8mm-nxp-bsp = "imx-boot u-boot.itb"
IMAGE_BOOT_FILES:mx8mm-nxp-bsp = "imx-boot u-boot.itb ${KERNEL_IMAGETYPE} ${@make_dtb_boot_files(d)} boot.scr uEnv.txt"
IMAGE_BOOT_FILES:sota:mx8mm-nxp-bsp = "boot.itb"
WKS_FILE_DEPENDS:append:mx8mm-generic-bsp = " u-boot-default-script imx-boot"
PREFERRED_PROVIDER_u-boot-default-script:mx8mm-generic-bsp = "u-boot-base-scr"
PREFERRED_PROVIDER_u-boot-default-script:sota:mx8mm-generic-bsp = "u-boot-ostree-scr-fit"
KERNEL_IMAGETYPE:sota:mx8mm-generic-bsp = "fitImage"
KERNEL_CLASSES:sota:mx8mm-generic-bsp = " kernel-lmp-fitimage "
## iMX8: Use latest NXP BSP downstream kernel
PREFERRED_PROVIDER_virtual/kernel:mx8mm-nxp-bsp ?= "linux-lmp-fslc-imx"
IMXBOOT_TARGETS:mx8mm-nxp-bsp = "flash_evk_spl"
PREFERRED_VERSION_u-boot-fio:mx8mm-nxp-bsp ?= "imx-2024.04"
## LUKS
OSTREE_SPLIT_BOOT:mx8mm-nxp-bsp = "${@bb.utils.contains('DISTRO_FEATURES', 'luks', '1', '0', d)}"
OSTREE_DEPLOY_USR_OSTREE_BOOT:mx8mm-nxp-bsp = "${@bb.utils.contains('DISTRO_FEATURES', 'luks', '1', '0', d)}"
WKS_FILE:sota:mx8mm-nxp-bsp = "${@bb.utils.contains('DISTRO_FEATURES', 'luks', 'sdimage-imx8m-spl-split-boot-sota.wks.in', 'sdimage-imx8m-spl-sota.wks.in', d)}"
## iMX8MM EVK
UBOOT_SIGN_ENABLE:sota:imx8mm-lpddr4-evk ?= "1"
MACHINE_FIRMWARE:append:imx8mm-lpddr4-evk = " linux-firmware-qca"
KMACHINE:imx8mm-lpddr4-evk = "imx8mmevk"
OSTREE_KERNEL_ARGS:imx8mm-lpddr4-evk ?= "console=tty1 console=ttymxc1,115200 earlycon=ec_imx6q,0x30890000,115200 rootfstype=ext4"
SOTA_CLIENT_FEATURES:append:imx8mm-lpddr4-evk = " ubootenv"
BOOTSCR_LOAD_ADDR:imx8mm-lpddr4-evk = "0x44800000"
## iMX8MM EVK with secure boot support
SOTA_CLIENT_FEATURES:remove:sota:imx8mm-lpddr4-evk-sec = "ubootenv"
## iMX8MM EVK with EBBR / SystemReady
UBOOT_SIGN_ENABLE:sota:imx8mm-lpddr4-evk-ebbr ?= ""
KERNEL_IMAGETYPE:sota:imx8mm-lpddr4-evk-ebbr ?= "Image"
KERNEL_CLASSES:sota:imx8mm-lpddr4-evk-ebbr ?= ""
EFI_PROVIDER:imx8mm-lpddr4-evk-ebbr ?= "grub-efi"
OSTREE_BOOTLOADER:imx8mm-lpddr4-evk-ebbr ?= "grub"
OSTREE_KERNEL_ARGS:append:imx8mm-lpddr4-evk-ebbr = " root=LABEL=otaroot"
IMAGE_EFI_BOOT_FILES:sota:imx8mm-lpddr4-evk-ebbr ?= "${@make_efi_dtb_boot_files(d)}"
WKS_FILE:sota:imx8mm-lpddr4-evk-ebbr ?= "efidisk-sota.wks.in"
# iMX8MM EVKB revision
KERNEL_MODULE_AUTOLOAD:append:imx8mm-lpddr4-evk = " moal"
KERNEL_MODULE_PROBECONF:append:imx8mm-lpddr4-evk = " moal"
module_conf_moal:imx8mm-lpddr4-evk = "options moal mod_para=nxp/wifi_mod_para.conf drvdbg=0x6 sta_name=wlan drv_mode=3"
MACHINE_FEATURES:append:imx8mm-lpddr4-evk = " mxm-mwifiex-load"

# iMX8MP
UBOOT_SIGN_ENABLE:sota:mx8mp-generic-bsp ??= "1"
IMX_DEFAULT_BOOTLOADER:mx8mp-generic-bsp ?= "u-boot-fio"
UBOOT_ENTRYPOINT:mx8mp-generic-bsp = "0x40400000"
UBOOT_DTB_LOADADDRESS:mx8mp-generic-bsp = "0x43000000"
PREFERRED_PROVIDER_virtual/trusted-firmware-a:mx8mp-nxp-bsp ?= "imx-atf"
EXTRA_IMAGEDEPENDS:append:mx8mp-nxp-bsp = "virtual/trusted-firmware-a"
UBOOT_CLASSES:mx8mp-generic-bsp = "uboot-fitimage"
ATF_BINARY:mx8mp-generic-bsp = "arm-trusted-firmware.bin"
LMP_BOOT_FIRMWARE_FILES:mx8mp-nxp-bsp = "imx-boot u-boot.itb"
IMAGE_BOOT_FILES:mx8mp-nxp-bsp = "imx-boot u-boot.itb ${KERNEL_IMAGETYPE} ${@make_dtb_boot_files(d)} boot.scr uEnv.txt"
IMAGE_BOOT_FILES:sota:mx8mp-nxp-bsp = "boot.itb"
WKS_FILE_DEPENDS:append:mx8mp-generic-bsp = " u-boot-default-script imx-boot"
PREFERRED_PROVIDER_u-boot-default-script:mx8mp-generic-bsp = "u-boot-base-scr"
PREFERRED_PROVIDER_u-boot-default-script:sota:mx8mp-generic-bsp = "u-boot-ostree-scr-fit"
KERNEL_IMAGETYPE:sota:mx8mp-generic-bsp = "fitImage"
KERNEL_CLASSES:sota:mx8mp-generic-bsp = " kernel-lmp-fitimage "
## iMX8: Use latest NXP BSP downstream kernel
PREFERRED_PROVIDER_virtual/kernel:mx8mp-nxp-bsp ?= "linux-lmp-fslc-imx"
WKS_FILE:sota:mx8mp-nxp-bsp = "sdimage-imx8m-spl-sota.wks.in"
IMXBOOT_TARGETS:mx8mp-nxp-bsp ?= "flash_evk_spl"
PREFERRED_VERSION_u-boot-fio:mx8mp-nxp-bsp ?= "imx-2024.04"
## iMX8MP EVK
UBOOT_SIGN_ENABLE:sota:imx8mp-lpddr4-evk ?= "1"
OSTREE_KERNEL_ARGS:imx8mp-lpddr4-evk ?= "console=tty1 console=ttymxc1,115200 earlycon=ec_imx6q,0x30890000,115200 rootfstype=ext4"
SOTA_CLIENT_FEATURES:append:imx8mp-lpddr4-evk = " ubootenv"
BOOTSCR_LOAD_ADDR:imx8mp-lpddr4-evk = "0x44800000"
KERNEL_DEVICETREE:append:imx8mp-lpddr4-evk = " freescale/imx8mp-evk-revb4.dtb"
## iMX8MP EVK with secure boot support
UBOOT_SIGN_ENABLE:sota:imx8mp-lpddr4-evk-sec ?= "1"
SOTA_CLIENT_FEATURES:remove:sota:imx8mp-lpddr4-evk-sec = "ubootenv"
## iMX8MP EVK with EBBR / SystemReady
UBOOT_SIGN_ENABLE:sota:imx8mp-lpddr4-evk-ebbr ?= ""
KERNEL_IMAGETYPE:sota:imx8mp-lpddr4-evk-ebbr ?= "Image"
KERNEL_CLASSES:sota:imx8mp-lpddr4-evk-ebbr ?= ""
EFI_PROVIDER:imx8mp-lpddr4-evk-ebbr ?= "grub-efi"
OSTREE_BOOTLOADER:imx8mp-lpddr4-evk-ebbr ?= "grub"
OSTREE_KERNEL_ARGS:append:imx8mp-lpddr4-evk-ebbr = " root=LABEL=otaroot"
IMAGE_EFI_BOOT_FILES:sota:imx8mp-lpddr4-evk-ebbr ?= "${@make_efi_dtb_boot_files(d)}"
WKS_FILE:sota:imx8mp-lpddr4-evk-ebbr ?= "efidisk-sota.wks.in"
# imx8mp comes with an AzureWave CM276MA PCIe Card
KERNEL_MODULE_AUTOLOAD:append:imx8mp-lpddr4-evk = " moal"
KERNEL_MODULE_PROBECONF:append:imx8mp-lpddr4-evk = " moal"
module_conf_moal:imx8mp-lpddr4-evk = "options moal mod_para=nxp/wifi_mod_para.conf drvdbg=0x6 sta_name=wlan drv_mode=3"
MACHINE_FEATURES:append:imx8mp-lpddr4-evk = " mxm-mwifiex-load"

# iMX8MN
UBOOT_SIGN_ENABLE:sota:mx8mn-generic-bsp ??= "1"
IMX_DEFAULT_BOOTLOADER:mx8mn-generic-bsp ?= "u-boot-fio"
UBOOT_ENTRYPOINT:mx8mn-generic-bsp = "0x40400000"
UBOOT_DTB_LOADADDRESS:mx8mn-generic-bsp = "0x43000000"
PREFERRED_PROVIDER_virtual/trusted-firmware-a:mx8mn-generic-bsp ?= "imx-atf"
EXTRA_IMAGEDEPENDS:append:mx8mn-generic-bsp = "virtual/trusted-firmware-a"
UBOOT_CLASSES:mx8mn-generic-bsp = "uboot-fitimage"
ATF_BINARY:mx8mn-generic-bsp = "arm-trusted-firmware.bin"
LMP_BOOT_FIRMWARE_FILES:mx8mn-generic-bsp = "imx-boot u-boot.itb"
IMAGE_BOOT_FILES:mx8mn-generic-bsp = "imx-boot u-boot.itb ${KERNEL_IMAGETYPE} ${@make_dtb_boot_files(d)} boot.scr uEnv.txt"
IMAGE_BOOT_FILES:sota:mx8mn-generic-bsp = "boot.itb"
WKS_FILE_DEPENDS:append:mx8mn-generic-bsp = " u-boot-default-script imx-boot"
PREFERRED_PROVIDER_u-boot-default-script:mx8mn-generic-bsp = "u-boot-base-scr"
PREFERRED_PROVIDER_u-boot-default-script:sota:mx8mn-generic-bsp = "u-boot-ostree-scr-fit"
KERNEL_IMAGETYPE:sota:mx8mn-generic-bsp = "fitImage"
KERNEL_CLASSES:sota:mx8mn-generic-bsp = " kernel-lmp-fitimage "
PREFERRED_VERSION_u-boot-fio:mx8mn-nxp-bsp ?= "imx-2024.04"
## iMX8: Use latest NXP BSP downstream kernel
PREFERRED_PROVIDER_virtual/kernel:mx8mn-generic-bsp ?= "linux-lmp-fslc-imx"
WKS_FILE:sota:mx8mn-generic-bsp = "sdimage-imx8m-spl-sota.wks.in"
# iMX8MN DDR4 EVK
UBOOT_SIGN_ENABLE:sota:imx8mn-ddr4-evk ?= "1"
KMACHINE:imx8mn-ddr4-evk = "imx8mn-evk"
OSTREE_KERNEL_ARGS:imx8mn-ddr4-evk ?= "console=tty1 console=ttymxc1,115200 earlycon=ec_imx6q,0x30890000,115200 rootfstype=ext4"
SOTA_CLIENT_FEATURES:append:imx8mn-ddr4-evk = " ubootenv"
BOOTSCR_LOAD_ADDR:imx8mn-ddr4-evk = "0x44800000"
MACHINE_EXTRA_RRECOMMENDS:append:imx8mn-ddr4-evk = " bluetooth-attach"
IMXBOOT_TARGETS:imx8mn-ddr4-evk ?= "flash_evk_spl_ddr4"
## iMX8MN DDR4 EVK with secure boot support
SOTA_CLIENT_FEATURES:remove:sota:imx8mn-ddr4-evk-sec = "ubootenv"
# iMX8MN LPDDR4 EVK
UBOOT_SIGN_ENABLE:sota:imx8mn-lpddr4-evk ?= "1"
KMACHINE:imx8mn-lpddr4-evk = "imx8mn-evk"
OSTREE_KERNEL_ARGS:imx8mn-lpddr4-evk ?= "console=tty1 console=ttymxc1,115200 earlycon=ec_imx6q,0x30890000,115200 rootfstype=ext4"
SOTA_CLIENT_FEATURES:append:imx8mn-lpddr4-evk = " ubootenv"
BOOTSCR_LOAD_ADDR:imx8mn-lpddr4-evk = "0x44800000"
MACHINE_EXTRA_RRECOMMENDS:append:imx8mn-lpddr4-evk = " bluetooth-attach"
IMXBOOT_TARGETS:imx8mn-lpddr4-evk ?= "flash_evk_spl"
MACHINE_FEATURES:append:imx8mn-lpddr4-evk = " mxm-mwifiex-load"
## iMX8MN LPDDR4 EVK with secure boot support
SOTA_CLIENT_FEATURES:remove:sota:imx8mn-lpddr4-evk-sec = "ubootenv"

# iMX93
UBOOT_SIGN_ENABLE:sota:mx93-generic-bsp ??= "1"
IMX_DEFAULT_BOOTLOADER:mx93-generic-bsp ?= "u-boot-fio"
UBOOT_ENTRYPOINT:mx93-generic-bsp = "0x80400000"
UBOOT_LOADADDRESS:mx93-generic-bsp = "0x80400000"
UBOOT_DTB_LOADADDRESS:mx93-generic-bsp = "0x83000000"
PREFERRED_PROVIDER_virtual/trusted-firmware-a:mx93-nxp-bsp ?= "imx-atf"
UBOOT_CLASSES:mx93-generic-bsp = "uboot-fitimage"
IMXBOOT_TARGETS:mx93-nxp-bsp ?= "flash_singleboot_spl"
ATF_BINARY:mx93-generic-bsp = "arm-trusted-firmware.bin"
EXTRA_IMAGEDEPENDS:append:mx93-generic-bsp = "virtual/trusted-firmware-a"
KERNEL_IMAGETYPE:sota:mx93-generic-bsp = "fitImage"
KERNEL_CLASSES:sota:mx93-generic-bsp = " kernel-lmp-fitimage "
WKS_FILE:sota:mx93-generic-bsp = "emmc-imx-gpt-sota.wks"
WKS_FILE_DEPENDS:append:mx93-generic-bsp = " u-boot-default-script imx-boot"
IMAGE_BOOT_FILES:mx93-generic-bsp = "${KERNEL_IMAGETYPE} ${@make_dtb_boot_files(d)} boot.scr uEnv.txt"
IMAGE_BOOT_FILES:sota:mx93-generic-bsp = "boot.itb"
PREFERRED_PROVIDER_u-boot-default-script:mx93-generic-bsp = "u-boot-base-scr"
PREFERRED_PROVIDER_u-boot-default-script:sota:mx93-generic-bsp = "u-boot-ostree-scr-fit"
SOTA_CLIENT_FEATURES:append:mx93-generic-bsp = " ubootenv"
LMP_BOOT_FIRMWARE_FILES:mx93-nxp-bsp = "imx-boot u-boot.itb"
PREFERRED_VERSION_optee-os-fio:mx93-nxp-bsp = "4.4.0-imx"
PREFERRED_VERSION_optee-os-fio-mfgtool:mx93-nxp-bsp = "4.4.0-imx"
PREFERRED_VERSION_optee-os-tadevkit:mx93-nxp-bsp = "4.4.0-imx"
PREFERRED_PROVIDER_virtual/kernel:mx93-nxp-bsp ?= "linux-lmp-fslc-imx"
PREFERRED_VERSION_u-boot-fio:mx93-nxp-bsp ?= "imx-2024.04"
## iMX93 DDR4 EVK
UBOOT_SIGN_ENABLE:sota:imx93-11x11-lpddr4x-evk ?= "1"
OSTREE_KERNEL_ARGS:imx93-11x11-lpddr4x-evk ?= "console=tty1 console=ttyLP0,115200 earlycon rootfstype=ext4"
BOOTSCR_LOAD_ADDR:imx93-11x11-lpddr4x-evk = "0x83500000"
UBOOT_SUFFIX:imx93-11x11-lpddr4x-evk = "bin"
UBOOT_DTB_NAME:imx93-11x11-lpddr4x-evk ?= "imx93-11x11-evk.dtb"

# Cross machines / BSPs

## iMX targets should use the u-boot release based on the NXP BSP
PREFERRED_VERSION_u-boot-fio:imx-nxp-bsp ?= "imx-2022.04"
## Prefer OP-TEE releases from our layer instead of using the .imx fork
PREFERRED_VERSION_optee-client:mx8-nxp-bsp = "4.4.0"
PREFERRED_VERSION_optee-client:mx9-nxp-bsp = "4.4.0"
PREFERRED_VERSION_optee-examples:mx8-nxp-bsp = "4.4.0"
PREFERRED_VERSION_optee-examples:mx9-nxp-bsp = "4.4.0"
PREFERRED_VERSION_optee-test:mx8-nxp-bsp = "4.4.0"
PREFERRED_VERSION_optee-test:mx9-nxp-bsp = "4.4.0"
## We don't use imx-boot-container just yet
UBOOT_PROVIDES_BOOT_CONTAINER:mx8m-generic-bsp = "0"
## No need to install u-boot, already a WKS dependency
MACHINE_ESSENTIAL_EXTRA_RDEPENDS:remove:imx-generic-bsp = "u-boot-fslc"
## OP-TEE is a dependency of u-boot (fit), no need for WKS_FILE_DEPENDS
OPTEE_WKS_FILE_DEPENDS:imx-generic-bsp = ""
# Use latest SDMA firmware from firmware-imx instead of upstream linux-firmware
MACHINE_FIRMWARE:remove:mx6-nxp-bsp = "linux-firmware-imx-sdma-imx6q"
MACHINE_FIRMWARE:remove:mx8-nxp-bsp = "linux-firmware-imx-sdma-imx7d"
MACHINE_FIRMWARE:append:mx6-nxp-bsp = " firmware-imx-sdma-imx6q firmwared"
MACHINE_FIRMWARE:append:mx8-nxp-bsp = " firmware-imx-sdma-imx7d firmwared"
```
